## guest/Config.in
```kconfig
source "$BR2_EXTERNAL_ORBIT_PATH/package/orbit-flight/Config.in"
source "$BR2_EXTERNAL_ORBIT_PATH/package/orbit-driver/Config.in"
```

## guest/configs/orbit_aarch64_defconfig
```kconfig
BR2_aarch64=y
BR2_PACKAGE_HOST_LINUX_HEADERS_CUSTOM_6_12=y
BR2_GLOBAL_PATCH_DIR="board/qemu/patches"
BR2_DOWNLOAD_FORCE_CHECK_HASHES=y
BR2_SYSTEM_DHCP="eth0"
BR2_ROOTFS_POST_IMAGE_SCRIPT="board/qemu/post-image.sh"
BR2_ROOTFS_POST_SCRIPT_ARGS="$(BR2_DEFCONFIG)"
BR2_LINUX_KERNEL=y
BR2_LINUX_KERNEL_CUSTOM_VERSION=y
BR2_LINUX_KERNEL_CUSTOM_VERSION_VALUE="6.12.27"
BR2_LINUX_KERNEL_USE_CUSTOM_CONFIG=y
BR2_LINUX_KERNEL_CUSTOM_CONFIG_FILE="$(BR2_EXTERNAL_ORBIT_PATH)/board/linux.config"
BR2_LINUX_KERNEL_NEEDS_HOST_OPENSSL=y
BR2_TARGET_ROOTFS_EXT2=y
BR2_TARGET_ROOTFS_EXT2_4=y
# BR2_TARGET_ROOTFS_TAR is not set
BR2_PACKAGE_HOST_QEMU=y
BR2_PACKAGE_HOST_QEMU_SYSTEM_MODE=y
BR2_TOOLCHAIN_BUILDROOT_GLIBC=y
BR2_TOOLCHAIN_BUILDROOT_CXX=y
BR2_GCC_VERSION_13_X=y
BR2_PACKAGE_OPENSSL=y
BR2_PACKAGE_LIBOPENSSL_BIN=y
BR2_PACKAGE_GLIBC_UTILS=y
BR2_PACKAGE_ORBIT_FLIGHT=y
BR2_TARGET_ROOTFS_EXT2_SIZE="256M"
BR2_TARGET_GENERIC_HOSTNAME="orbit-guest"
BR2_PACKAGE_SQLITE=y
BR2_GNU_MIRROR="https://ftp.gnu.org/gnu"
BR2_WGET="wget --passive-ftp -nd -t 3 --connect-timeout=15 --read-timeout=30"
```

## guest/package/orbit-driver/Config.in
```kconfig
config BR2_PACKAGE_ORBIT_DRIVER
	bool "OrbitalLink test driver and syscall harness"
	depends on BR2_LINUX_KERNEL
	help
	  Disposable-guest test backend, not the M7 MMIO peripheral driver.
```

## guest/package/orbit-flight/Config.in
```kconfig
config BR2_PACKAGE_ORBIT_FLIGHT
	bool "OrbitalLink flight service"
	depends on BR2_INSTALL_LIBSTDCPP
	depends on BR2_TOOLCHAIN_HAS_THREADS
	select BR2_PACKAGE_OPENSSL
	help
	  Build the fake-source service using the same target toolchain and
	  OpenSSL sysroot as the ARM64 image. No credentials are installed.
```
